## zmk/config/boards/shields/catpucciano/Kconfig.shield
```kconfig
# Copyright (c) 2022 The ZMK Contributors
# SPDX-License-Identifier: MIT

config SHIELD_CATPUCCIANO_LEFT
    def_bool $(shields_list_contains,catpucciano_left)

config SHIELD_CATPUCCIANO_RIGHT
    def_bool $(shields_list_contains,catpucciano_right)
```
